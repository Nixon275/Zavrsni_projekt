## greenhouse/main/Kconfig.projbuild
```kconfig
menu "Greenhouse configuration"

    menu "Sensor configuration"
        config SENSOR_SAMPLE_TIME
            int "Sensor Sampling Time"
            default 20
            help
                Sensor sampling time in seconds.
    endmenu
    
    menu "Actuator configuration"
    
        menu "Heater Device"
            config HEATER_MIN_TEMP
                int "Heater Device MIN TEMP"
                default 18
                help
                    Lower temperature threshold for heater device.
            
            config HEATER_MAX_TEMP
                int "Heater Device MAX TEMP"
                default 30
                help
                    Higher temperature threshold for heater device.
    
            config HEATER_DEFAULT_TEMP
                int "Heater Device DEFAULT TEMP"
                default 23
                help
                    Default temperature for heater device.
    
            config HEATER_ACTIVE_DURATION
                int "Heater active duration"
                default 15
                help
                    Heater active time in seconds.
        endmenu  
    
        menu "Water pump Device"
            config WATER_PUMP_DEFAULT_SOIL_MOISTURE
                int "Water pump default soil moisture"
                default 50
                range 0 100
                help
                    Water pump default relative soil moisture.
    
            config WATER_PUMP_ACTIVE_DURATION
                int "Water pump active duration"
                default 10
                help
                    Water pump active time in seconds.
        endmenu 
    
    endmenu
    
    menu "Power save options"
        config EXAMPLE_WIFI_LISTEN_INTERVAL
            int "WiFi listen interval"
            default 3
            help
                Interval for station to listen to beacon from AP. The unit of listen interval is one beacon interval.
                For example, if beacon interval is 100 ms and listen interval is 3, the interval for station to listen
                to beacon is 300 ms.
    
        config EXAMPLE_WIFI_BEACON_TIMEOUT
            int "WiFi beacon timeout"
            default 6
            range 6 30
            help
                For Station, If the station does not receive a beacon frame from the connected SoftAP during the
                inactive time, disconnect from SoftAP. Default 6s.
    
        choice EXAMPLE_MAX_CPU_FREQ
            prompt "Maximum CPU frequency"
            default EXAMPLE_MAX_CPU_FREQ_80
            depends on PM_ENABLE
            help
                Maximum CPU frequency to use for dynamic frequency scaling.
    
            config EXAMPLE_MAX_CPU_FREQ_80
                bool "80 MHz"
            config EXAMPLE_MAX_CPU_FREQ_120
                bool "120 MHz"
                depends on IDF_TARGET_ESP32C2
            config EXAMPLE_MAX_CPU_FREQ_160
                bool "160 MHz"
                depends on !IDF_TARGET_ESP32C2
            config EXAMPLE_MAX_CPU_FREQ_240
                bool "240 MHz"
                depends on IDF_TARGET_ESP32 || IDF_TARGET_ESP32S2 || IDF_TARGET_ESP32S3
        endchoice
    
        config EXAMPLE_MAX_CPU_FREQ_MHZ
            int
            default 80 if EXAMPLE_MAX_CPU_FREQ_80
            default 120 if EXAMPLE_MAX_CPU_FREQ_120
            default 160 if EXAMPLE_MAX_CPU_FREQ_160
            default 240 if EXAMPLE_MAX_CPU_FREQ_240
    
        choice EXAMPLE_MIN_CPU_FREQ
            prompt "Minimum CPU frequency"
            default EXAMPLE_MIN_CPU_FREQ_10M
            depends on PM_ENABLE
            help
                Minimum CPU frequency to use for dynamic frequency scaling.
                Should be set to XTAL frequency or XTAL frequency divided by integer.
    
            config EXAMPLE_MIN_CPU_FREQ_40M
                bool "40 MHz (use with 40MHz XTAL)"
                depends on XTAL_FREQ_40 || XTAL_FREQ_AUTO
            config EXAMPLE_MIN_CPU_FREQ_20M
                bool "20 MHz (use with 40MHz XTAL)"
                depends on XTAL_FREQ_40 || XTAL_FREQ_AUTO
            config EXAMPLE_MIN_CPU_FREQ_10M
                bool "10 MHz (use with 40MHz XTAL)"
                depends on XTAL_FREQ_40 || XTAL_FREQ_AUTO
            config EXAMPLE_MIN_CPU_FREQ_26M
                bool "26 MHz (use with 26MHz XTAL)"
                depends on XTAL_FREQ_26 || XTAL_FREQ_AUTO
            config EXAMPLE_MIN_CPU_FREQ_13M
                bool "13 MHz (use with 26MHz XTAL)"
                depends on XTAL_FREQ_26 || XTAL_FREQ_AUTO
        endchoice
    
        config EXAMPLE_MIN_CPU_FREQ_MHZ
            int
            default 40 if EXAMPLE_MIN_CPU_FREQ_40M
            default 20 if EXAMPLE_MIN_CPU_FREQ_20M
            default 10 if EXAMPLE_MIN_CPU_FREQ_10M
            default 26 if EXAMPLE_MIN_CPU_FREQ_26M
            default 13 if EXAMPLE_MIN_CPU_FREQ_13M
    
    endmenu
    
    endmenu
    
```
